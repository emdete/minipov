
static const uint8_t const font_5x8[] PROGMEM = {
	0b01111110,
	0b10100001,
	0b10011001,
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	0b11111111, //unknown
	};
// bytes per char
#define font_width 5
// bytes per char including spaving (which is allways zero and not contained above)
#define font_widthw (font_width+1)


// font is 0-9 A-Z
static const void const* font_pattern(char c, uint8_t index) {
	if (index >= font_width) {
		return (void*)0;
	}
	uint16_t patterni = 0;
	if (c>='0' && c<='9') {
		patterni += c - '0';
	}
	else {
		patterni += 10;
		if (c>='A' && c<='Z') {
			patterni += c - 'A';
		}
		else if (c>='a' && c<='z') {
			patterni += c - 'a';
		}
		else {
			patterni += 26;
			if (c==' ') {
				;
			}
			else {
				patterni++;
			}
		}
	}
	patterni *= font_width;
	patterni += index;
	return font_5x8 + patterni;
}
